/*********************************************************************
Figgy's Flower Fest

A mini game written by Alex Zaykowski for the Arduino Nano on a
128x64 i2C display

-for Kaitlyn

5/3/2021
*********************************************************************/

#include <SPI.h>
#include <Wire.h>
#include <Adafruit_GFX.h>
#include <Adafruit_SSD1306.h>

#define OLED_RESET 4
Adafruit_SSD1306 display(OLED_RESET);

#define NUMFLAKES 10
#define XPOS 0
#define YPOS 1
#define DELTAY 2

#define right 5
#define left 7
int score = 0;
boolean rightState;
boolean leftState;
boolean lastPressed;
boolean gameOver = 0;
int x = 0;
int y = 48;

// snow (setting y below 0 doesn't do anything I think)
int snowX[]= {random(0, 128), random(0, 128), random(0, 128), random(0, 128)};
int snowY[] = {random(0, -100), random(0, -130), random(0, -310), random(0, -200)};

#define LOGO16_GLCD_HEIGHT 16 
#define LOGO16_GLCD_WIDTH  16 

#if (SSD1306_LCDHEIGHT != 64)
#error("Height incorrect, please fix Adafruit_SSD1306.h!");
#endif

const unsigned char PROGMEM launch_img [] = {
0x00, 0x00, 0x00, 0x00, 0x00, 0x00, 0x00, 0x00, 0x00, 0x00, 0x00, 0x00, 0x00, 0x00, 0x00, 0x00,
0x00, 0xC0, 0x00, 0x00, 0x00, 0x00, 0x00, 0x00, 0x00, 0x00, 0x00, 0x00, 0x00, 0x00, 0x00, 0x00,
0x01, 0x00, 0x00, 0x00, 0x41, 0x80, 0x00, 0x00, 0x00, 0x00, 0x00, 0x00, 0x00, 0x00, 0x00, 0x00,
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0x00, 0x00, 0x00, 0x00, 0x00, 0x00, 0x00, 0x00, 0x7F, 0xC0, 0x00, 0x0E, 0x00, 0x00, 0x00, 0x00
};
const unsigned char PROGMEM win_img [] = {
0x00, 0x00, 0x00, 0x00, 0x00, 0x00, 0x00, 0x00, 0x00, 0x00, 0x00, 0x00, 0x00, 0x00, 0x80, 0x00,
0x00, 0x00, 0x00, 0x00, 0x00, 0x00, 0x00, 0x00, 0xE4, 0x00, 0x00, 0x00, 0x00, 0x08, 0x80, 0x00,
0x00, 0x00, 0x00, 0x00, 0x00, 0x00, 0x00, 0x07, 0x24, 0x00, 0x00, 0x00, 0x00, 0x88, 0x80, 0x00,
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0x00, 0x00, 0x00, 0x00, 0x00, 0x00, 0xFF, 0x80, 0x00, 0x1F, 0x00, 0x00, 0x01, 0x00, 0x00, 0x00
};

const unsigned char PROGMEM pooped [] = {
0x00, 0x00, 0x00, 0x00, 0x0F, 0xE0, 0x00, 0x00, 0x00, 0x00, 0x40, 0x00, 0x00, 0x00, 0x00, 0x00,
0x00, 0x00, 0x00, 0x00, 0x08, 0x30, 0x00, 0x00, 0x00, 0x00, 0x40, 0x40, 0x41, 0x00, 0x00, 0x00,
0x00, 0x00, 0x00, 0x00, 0x0C, 0x18, 0x00, 0x00, 0x00, 0x00, 0x40, 0x40, 0x41, 0x00, 0x00, 0x00,
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0x00, 0x00, 0x00, 0x00, 0x00, 0x00, 0x00, 0x7E, 0x00, 0x00, 0x00, 0x00, 0x00, 0x00, 0x00, 0x00
};
const unsigned char PROGMEM figgy_right [] = {
0x08, 0x00, 0x0C, 0x00, 0x0F, 0x00, 0x1F, 0x80, 0x1E, 0x80, 0x1F, 0x80, 0x1F, 0x80, 0x0F, 0x22,
0x8F, 0xE2, 0x4F, 0x22, 0x4F, 0xE2, 0x2F, 0x3E, 0x1F, 0x00, 0x0F, 0x00, 0x09, 0x00, 0x0D, 0x80
};
const unsigned char PROGMEM figgy_left[] = {
0x00, 0x10, 0x00, 0x30, 0x00, 0xF0, 0x01, 0xF8, 0x01, 0x78, 0x01, 0xF8, 0x01, 0xF8, 0x44, 0xF0,
0x47, 0xF1, 0x44, 0xF2, 0x47, 0xF2, 0x7C, 0xF4, 0x00, 0xF8, 0x00, 0xF0, 0x00, 0x90, 0x01, 0xB0
};

void setup()   {      
  pinMode(right, INPUT_PULLUP);  
  pinMode(left, INPUT_PULLUP); 
  Serial.begin(9600);

  // by default, we'll generate the high voltage from the 3.3v line internally! (neat!)
  display.begin(SSD1306_SWITCHCAPVCC, 0x3C);  // initialize with the I2C addr 0x3C (for the 128x32)
  // init done
  display.drawBitmap(0, 0,  launch_img, 128, 164, WHITE);
  display.display();
  delay(7000);
  display.clearDisplay();
}
void drawFiggyRight(){
    display.drawBitmap(x, y,  figgy_right, 16, 16, WHITE);
}
void drawFiggyLeft(){
    display.drawBitmap(x, y,  figgy_left, 16, 16, WHITE);
}
void displayScore(){
  display.setTextSize(1);
  display.setTextColor(WHITE);
  display.setCursor(0,0);
  display.print("Score: ");
  display.setCursor(50,0);
  display.print(score);
}
void displayGameOver(){
  display.clearDisplay();
  for(;;){
    display.drawBitmap(0, 0,  pooped, 128, 164, WHITE);
    display.display();
  }
}
void displayWin(){
  if(gameOver = 1){
    display.clearDisplay();
    display.drawBitmap(0, 0,  win_img, 128, 164, WHITE);
    display.display();
    delay(7000);
  }
}
boolean hitTest(int i){
  if(snowX[i] > x && snowX[i] < x+16 && snowY[i]>= 48 && snowY[i] < 64){
    score += 1;
    return 1;
  }else{
    return 0;
  }
}
void drawPetals(){
    for(int i=0; i<4; i++){
      if(snowY[i] > 64 || hitTest(i)==1){
        snowX[i] = random(0, 128);
        snowY[i] = random(0, -300);
      }
      snowY[i] += random(1,3);
      display.drawPixel(snowX[i], snowY[i], WHITE);
  }
}
void loop() {
  // if game is won
  if(score == 50 && gameOver == 0){
    displayWin();
    gameOver = 1;
  }
  if(score == 100 && gameOver == 1){
    displayGameOver();
  }
  rightState = digitalRead(right);
  leftState = digitalRead(left);
  displayScore();
  
  drawPetals();
  
  if(rightState == 0){
    if(x < 112){
      x+=3;
    }
    lastPressed = 0;
    drawFiggyRight();
  }else if(leftState == 0){
    if(x > 3){
        x-=3;
    }
    lastPressed = 1;
    drawFiggyLeft();
  }else{
    if(lastPressed == 0){
      drawFiggyRight();
    }else{
      drawFiggyLeft();
    }
  }
  display.display();
  display.clearDisplay();
}
